## firmware/blink/main/Kconfig.projbuild
```kconfig
menu "Blink de prueba"

    config BLINK_GPIO
        int "GPIO del LED"
        range 0 33
        default 2
        help
            GPIO donde está el LED. En la mayoría de ESP32 DevKit V1 el LED azul
            está en GPIO2. La DevKitC de Espressif no trae LED de usuario: conecta
            uno externo (LED + resistencia de 220 ohm a GND) o guíate por el serial.

    config BLINK_PERIOD_MS
        int "Periodo de parpadeo (ms)"
        range 50 5000
        default 500

endmenu
```

## firmware/components/csi_wifi/Kconfig
```kconfig
menu "CSI WiFi"

    config CSI_WIFI_SSID
        string "Nombre de la red WiFi (SSID)"
        default "mi_red"
        help
            Red de 2.4 GHz del router. TX y RX se conectan a la misma red para quedar en el mismo canal.

    config CSI_WIFI_PASSWORD
        string "Contrasena del WiFi"
        default ""

endmenu
```

## firmware/csi_router_test/main/Kconfig.projbuild
```kconfig
menu "CSI router test"

    config CSI_WIFI_SSID
        string "Nombre de la red WiFi (SSID)"
        default "mi_red"
        help
            Red de 2.4 GHz a la que se conecta la placa.

    config CSI_WIFI_PASSWORD
        string "Contrasena del WiFi"
        default ""

    config CSI_PING_HZ
        int "Pings por segundo al router"
        range 10 200
        default 100
        help
            Cada respuesta del router produce un paquete CSI.

    config CSI_QUEUE_LEN
        int "Largo de la cola de paquetes CSI"
        range 8 128
        default 32

endmenu
```

## firmware/rx/main/Kconfig.projbuild
```kconfig
menu "CSI receptor"

    choice CSI_RX_SOURCE
        prompt "Fuente de CSI"
        default CSI_RX_SOURCE_TX
        help
            De dónde salen los paquetes que se miden.

        config CSI_RX_SOURCE_TX
            bool "Transmisor dedicado (ESP-NOW)"
        config CSI_RX_SOURCE_ROUTER
            bool "Router (ping)"
    endchoice

    config CSI_RX_TX_MAC
        string "MAC del transmisor"
        default "F4:2D:C9:6B:26:C0"
        depends on CSI_RX_SOURCE_TX
        help
            MAC WiFi (STA) de la placa transmisora, formato AA:BB:CC:DD:EE:FF.

    config CSI_RX_PING_HZ
        int "Pings por segundo al router"
        range 10 200
        default 100
        depends on CSI_RX_SOURCE_ROUTER

    config CSI_RX_QUEUE_LEN
        int "Largo de la cola de paquetes CSI"
        range 8 128
        default 48

endmenu
```

## firmware/tx/main/Kconfig.projbuild
```kconfig
menu "CSI transmisor"

    config CSI_TX_HZ
        int "Beacons por segundo"
        range 10 200
        default 100

    config CSI_TX_LED_GPIO
        int "GPIO del LED de estado"
        range -1 33
        default 2
        help
            Parpadeo rápido: conectando al WiFi. Un destello por segundo: enviando beacons.
            -1 desactiva el LED.

    config CSI_TX_WIFI_TIMEOUT_S
        int "Segundos sin WiFi antes de reiniciar (y volver a la versión anterior si es una OTA nueva)"
        range 20 600
        default 60

endmenu
```
